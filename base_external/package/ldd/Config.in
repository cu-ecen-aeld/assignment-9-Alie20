## base_external/package/ldd/Config.in
```kconfig
config BR2_PACKAGE_LDD
    bool "ldd drivers (misc-modules + scull)"
    help
      Build and install misc-modules and scull drivers from the ldd3 source tree
```
